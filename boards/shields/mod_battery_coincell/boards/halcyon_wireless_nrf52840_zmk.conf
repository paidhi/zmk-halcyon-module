## boards/shields/mod_battery_coincell/boards/halcyon_wireless_nrf52840_zmk.conf
```kconfig
CONFIG_ZMK_BATTERY_REPORTING_FETCH_MODE_LITHIUM_VOLTAGE=y
CONFIG_ZMK_BATTERY_REPORT_INTERVAL=600
CONFIG_ZMK_RGB_UNDERGLOW_DISABLE_WHEN_USB_DISCONNECTED=y
CONFIG_ZMK_EXT_POWER_DISABLE_WHEN_USB_DISCONNECTED=y
CONFIG_ZMK_BLE_LOW_DUTY_ADVERTISING=y
```
