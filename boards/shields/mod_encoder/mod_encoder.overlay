/*
 * Copyright (c) 2026 Splitkb.com
 *
 * SPDX-License-Identifier: MIT
 */

/ {
    chosen {
        zmk,kscan = &kscan_composite;
    };
};

&kscan_halcyon {
    status = "okay";
    wakeup-source;
    input-gpios = <&vik_conn 0 (GPIO_ACTIVE_LOW | GPIO_PULL_UP)>;
};

&kscan_composite {
    status = "okay";
    wakeup-source;
};
